## mqtt-and-rtos/freertos-demo/main/Kconfig.projbuild
```kconfig
menu "Demo Configuration"

    orsource "$IDF_PATH/examples/common_components/env_caps/$IDF_TARGET/Kconfig.env_caps"

    config ESP_WIFI_SSID
        string "WiFi SSID"
        default "myssid"
        help
            SSID (network name) for the example to connect to.

    config ESP_WIFI_PASSWORD
        string "WiFi Password"
        default "mypassword"
        help
            WiFi password (WPA or WPA2) for the example to use.

    choice ESP_WIFI_SAE_MODE
        prompt "WPA3 SAE mode selection"
        default ESP_WPA3_SAE_PWE_BOTH
        help
            Select mode for SAE as Hunt and Peck, H2E or both.
        config ESP_WPA3_SAE_PWE_HUNT_AND_PECK
            bool "HUNT AND PECK"
        config ESP_WPA3_SAE_PWE_HASH_TO_ELEMENT
            bool "H2E"
        config ESP_WPA3_SAE_PWE_BOTH
            bool "BOTH"
    endchoice

    config ESP_WIFI_PW_ID
        string "PASSWORD IDENTIFIER"
        depends on  ESP_WPA3_SAE_PWE_HASH_TO_ELEMENT|| ESP_WPA3_SAE_PWE_BOTH
        default ""
        help
            password identifier for SAE H2E

    config ESP_WIFI_MAXIMUM_RETRY
        int "Maximum retry"
        default 5
        help
            Set the Maximum retry to avoid station reconnecting to the AP unlimited when the AP is really inexistent.

    choice ESP_WIFI_SCAN_AUTH_MODE_THRESHOLD
        prompt "WiFi Scan auth mode threshold"
        default ESP_WIFI_AUTH_WPA2_PSK
        help
            The weakest authmode to accept in the scan mode.
            This value defaults to ESP_WIFI_AUTH_WPA2_PSK incase password is present and ESP_WIFI_AUTH_OPEN is used.
            Please select ESP_WIFI_AUTH_WEP/ESP_WIFI_AUTH_WPA_PSK incase AP is operating in WEP/WPA mode.

        config ESP_WIFI_AUTH_OPEN
            bool "OPEN"
        config ESP_WIFI_AUTH_WEP
            bool "WEP"
        config ESP_WIFI_AUTH_WPA_PSK
            bool "WPA PSK"
        config ESP_WIFI_AUTH_WPA2_PSK
            bool "WPA2 PSK"
        config ESP_WIFI_AUTH_WPA_WPA2_PSK
            bool "WPA/WPA2 PSK"
        config ESP_WIFI_AUTH_WPA3_PSK
            bool "WPA3 PSK"
        config ESP_WIFI_AUTH_WPA2_WPA3_PSK
            bool "WPA2/WPA3 PSK"
        config ESP_WIFI_AUTH_WAPI_PSK
            bool "WAPI PSK"
    endchoice

    config MQTT_BROKER_URL
        string "MQTT Broker URL"
        default "mqtt://broker.emqx.io"
        help
            URL of the broker to connect to

    config MQTT_BROKER_CERTIFICATE_OVERRIDE
        string "MQTT Broker certificate override"
        default ""
        help
            Please leave empty if broker certificate included from a textfile; otherwise fill in a base64 part of PEM without any line breaks or spaces
            format certificate

    config MQTT_BROKER_CERTIFICATE_OVERRIDDEN
        bool
        default y if MQTT_BROKER_CERTIFICATE_OVERRIDE != ""

    config MQTT_USERNAME
        string "MQTT Username"
        default "myuser"
        help
            Username to use when connecting to the MQTT Broker

    config MQTT_PASSWORD
        string "MQTT Password"
        default "mypass"
        help
            Password to use when connecting to the MQTT Broker

    config MQTT_RECONNECT_INTERVAL
        int "MQTT Reconnect Interval"
        default 5000
        help
            The time interval for MQTT client to reconnect, in milliseconds

    config LED_STRIP_GPIO
        int "LED Strip GPIO Number"
        range ENV_GPIO_RANGE_MIN ENV_GPIO_OUT_RANGE_MAX
        default 38
        help
            GPIO number (IOxx) to control the LED

    config LED_TASK_PRIORITY
        int "LED task priority"
        default 4
        help
            LED task priority. Higher number denotes higher priority.

endmenu
```

## mqtt-demo/mqtt-and-microros/microros_demo/main/Kconfig.projbuild
```kconfig
menu "micro-ROS example-app settings"

    orsource "$IDF_PATH/examples/common_components/env_caps/$IDF_TARGET/Kconfig.env_caps"

    config MICRO_ROS_APP_NODE_NAME
        string "Node name of the micro-ROS app"
        default "microros_demo"
        help
            Node name of the micro-ROS app

    config MICRO_ROS_APP_STACK
        int "Stack the micro-ROS app (Bytes)"
        default 16000
        help
            Stack size in Bytes of the micro-ROS app

    config MICRO_ROS_APP_TASK_PRIO
        int "Priority of the micro-ROS app"
        default 5
        help
            Priority of micro-ros task higher value means higher priority

    config MICRO_ROS_APP_LED
        bool "Enable LED"
        default y
        help
            Enable LED

    config MICRO_ROS_APP_LED_STRIP_GPIO
        int "LED Strip GPIO Number"
        range ENV_GPIO_RANGE_MIN ENV_GPIO_OUT_RANGE_MAX
        default 38
        depends on MICRO_ROS_APP_LED
        help
            GPIO number (IOxx) to control the LED

    config MICRO_ROS_APP_LED_STATE_MESSAGE_INTERVAL
        int "LED State Message Interval"
        default 5000
        depends on MICRO_ROS_APP_LED
        help
            The publishing interval of LED state messages, in milliseconds
        
endmenu
```
